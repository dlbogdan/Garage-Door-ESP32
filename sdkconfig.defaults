## sdkconfig.defaults
```kconfig
CONFIG_IDF_TARGET="esp32"
CONFIG_PARTITION_TABLE_CUSTOM=y
CONFIG_PARTITION_TABLE_CUSTOM_FILENAME="partitions.csv"
CONFIG_PARTITION_TABLE_FILENAME="partitions.csv"
CONFIG_ESPTOOLPY_FLASHSIZE_4MB=y
CONFIG_ESPTOOLPY_FLASHSIZE="4MB"
CONFIG_COMPILER_CXX_EXCEPTIONS=n
CONFIG_COMPILER_CXX_RTTI=n
CONFIG_FREERTOS_HZ=1000
# app_main initializes Arduino/HomeSpan networking, migrates the bounded schema,
# and starts provisioning before returning. ESP-IDF's 3584-byte default is too
# small for that C++ call chain even after large configuration objects are moved
# to static/heap storage. The task is deleted when app_main returns, so this
# temporary startup allocation does not reduce steady-state heap.
CONFIG_ESP_MAIN_TASK_STACK_SIZE=8192
CONFIG_ESP_TASK_WDT_EN=y
CONFIG_ESP_TASK_WDT_INIT=y
CONFIG_ESP_TASK_WDT_TIMEOUT_S=5
CONFIG_BOOTLOADER_APP_ROLLBACK_ENABLE=y
CONFIG_NVS_ASSERT_ERROR_CHECK=y
# Arduino's optional diagnostics dependency otherwise installs global log
# wrappers that are incompatible with the ESP-IDF 5.5.4 Wi-Fi binary.
CONFIG_DIAG_USE_EXTERNAL_LOG_WRAP=y
```
